## CMakeLists.txt
```
# SPDX-License-Identifier: Apache-2.0

cmake_minimum_required(VERSION 3.20.0)
find_package(Zephyr REQUIRED HINTS $ENV{ZEPHYR_BASE})
project(shell_logging)

FILE(GLOB app_sources src/*.c)
target_sources(app PRIVATE ${app_sources})
```

## prj.conf
```kconfig
CONFIG_ZTEST=y
CONFIG_ZTEST_NEW_API=y

CONFIG_SHELL=y
CONFIG_SHELL_BACKEND_SERIAL=n
CONFIG_SHELL_BACKEND_DUMMY=y
CONFIG_SHELL_CMD_BUFF_SIZE=90
CONFIG_SHELL_PRINTF_BUFF_SIZE=15
CONFIG_SHELL_METAKEYS=n

CONFIG_TEST_LOGGING_DEFAULTS=n
CONFIG_LOG=y
CONFIG_LOG_BLOCK_IN_THREAD=y
```

## src/main.c
```c
/*
 * Copyright (c) 2022 Nordic Semiconductor ASA
 *
 * SPDX-License-Identifier: Apache-2.0
 */

/** @file
 *  @brief Interactive shell test suite
 *
 */

#include <zephyr/zephyr.h>
#include <zephyr/ztest.h>

#include <zephyr/shell/shell.h>
#include <zephyr/shell/shell_dummy.h>

static const struct shell *dummy_shell;

ZTEST(shell_logging, test_block)
{

}

static void *setup(void)
{
	dummy_shell = shell_backend_dummy_get_ptr();
}

static void before(void)
{
	/* Disable all execpt dummy backend. */
	STRUCT_SECTION_FOREACH(log_backend, backend) {
		if (backend != dummy_shell->log_backend->backend) {
			log_backend_deactivate(backend);
		} else {
			log_backend_activate(backend, backend->cb->ctx);
		}
	}
}

static void after(void)
{
	/* Enable all but disable dummy shell backend. */
	STRUCT_SECTION_FOREACH(log_backend, backend) {
		if (backend != dummy_shell->log_backend->backend) {
			log_backend_deactivate(backend);
		} else {
			log_backend_activate(backend, backend->cb->ctx);
		}
	}
}

ZTEST_SUITE(shell_logging, NULL, setup, before, after, NULL);
```
