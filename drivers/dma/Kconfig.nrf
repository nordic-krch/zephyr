## drivers/dma/Kconfig.nrf
```kconfig
# Copyright (c) 2024 Nordic Semiconductor ASA
# SPDX-License-Identifier: Apache-2.0

config DMA_NRF_MVDMA
	bool "nRF MVDMA driver"
```

## drivers/misc/nordic_dppi/Kconfig
```kconfig
config NORDIC_DPPI
	select NRF_IRONSIDE_KRCH_SERVICE if SOC_NRF54H20_CPUAPP
	bool "DPPI manager"

config NORDIC_DPPI_MULTI_DOMAIN
	bool "DPPI with multiple domains"
	depends on $(dt_has_compat,$(DT_COMPAT_NORDIC_NRF_PPIB))
	default y
```

## drivers/misc/nordic_vpr_launcher/Kconfig
```kconfig
# Copyright (c) 2024 Nordic Semiconductor ASA
# SPDX-License-Identifier: Apache-2.0

config NORDIC_VPR_LAUNCHER
	bool "Nordic VPR coprocessor launcher"
	default y
	depends on DT_HAS_NORDIC_NRF_VPR_COPROCESSOR_ENABLED && \
		   $(dt_compat_any_has_prop,$(DT_COMPAT_NORDIC_NRF_VPR_COPROCESSOR),execution-memory)
	help
	  When enabled, the VPR coprocessors will be automatically launched
	  during system initialization.

if NORDIC_VPR_LAUNCHER

module = NORDIC_VPR_LAUNCHER
module-str = Nordic VPR Launcher
source "subsys/logging/Kconfig.template.log_config"

VAR_NRF_IRONSIDE_CALL_INIT_PRIORITY := NRF_IRONSIDE_CALL_INIT_PRIORITY

config NORDIC_VPR_LAUNCHER_INIT_PRIORITY
	int "Nordic VPR coprocessor launcher init priority"
	default 43 if SOC_NRF54H20_TDD_ENABLE
	default 0
	help
	  The init priority of the VPR coprocessor launcher.

endif # NORDIC_VPR_LAUNCHER
```

## dts/bindings/clock/nordic,nrfx-clock-xo.yaml
```yaml
# Copyright (c) 2025 Nordic Semiconductor ASA
# SPDX-License-Identifier: Apache-2.0

description: Nordic nRF XO clock control node

compatible: "nordic,nrfx-clock-xo"

include: [base.yaml, fixed-clock.yaml]
```

## dts/bindings/clock/nordic,nrfx-clock-xo24m.yaml
```yaml
# Copyright (c) 2025 Nordic Semiconductor ASA
# SPDX-License-Identifier: Apache-2.0

description: Nordic nRF XO24M clock control node

compatible: "nordic,nrfx-clock-xo24m"

include: [base.yaml, fixed-clock.yaml]
```

## dts/bindings/misc/nordic,nrf-tpiu.yaml
```yaml
# Copyright (c) 2025 Nordic Semiconductor ASA
# SPDX-License-Identifier: Apache-2.0

description: Nordic TPIU (Trace Port Interface Unit)

compatible: "nordic,nrf-tpiu"

include: [base.yaml, pinctrl-device.yaml, nordic-clockpin.yaml]

properties:
  reg:
    required: true

  pinctrl-0:
    required: true

  pinctrl-names:
    required: true
```

## soc/nordic/common/ppi/Kconfig
```kconfig
config NORDIC_GPPI
	select NRF_IRONSIDE_KRCH_SERVICE if SOC_NRF54H20_CPUAPP
	bool "DPPI manager"

if NORDIC_GPPI
config NORDIC_GPPI_PPI
	bool
	depends on $(dt_nodelabel_exists,ppi)
	default y

config NORDIC_DPPI_MULTI_DOMAIN
	bool "DPPI with multiple domains"
	depends on $(dt_has_compat,$(DT_COMPAT_NORDIC_NRF_PPIB))
	default y
endif
```

## soc/nordic/nrf54l/Kconfig.defconfig.nrf54lm20_a_b_cpuflpr
```kconfig
# Nordic Semiconductor nRF54LM20A and nRF54LM20B MCUs

# Copyright (c) 2025 Nordic Semiconductor ASA
# SPDX-License-Identifier: Apache-2.0

if SOC_NRF54LM20A_CPUFLPR || SOC_NRF54LM20B_CPUFLPR

config NUM_IRQS
	default 287

config SHELL_REMOTE_CLI_EP_NAME
	default "shell_remote_flpr"

config SHELL_REMOTE_CLI_COPY_RO_STRINGS
	default n

endif # SOC_NRF54LM20A_CPUFLPR || SOC_NRF54LM20B_CPUFLPR
```

## subsys/ipc/ipc_service/backends/Kconfig
```kconfig
# Copyright (c) 2021 Nordic Semiconductor (ASA)
# SPDX-License-Identifier: Apache-2.0

config IPC_SERVICE_REG_BACKEND_PRIORITY
	int "Initialization priority of modules registering IPC backend"
	default 46
	help
	  The backend must be registered before the endpoint register.

config IPC_SERVICE_BACKEND_RPMSG
	bool "OpenAMP RPMSG backend with static VRINGs"
	default y
	depends on MBOX
	depends on DT_HAS_ZEPHYR_IPC_OPENAMP_STATIC_VRINGS_ENABLED
	select IPC_SERVICE_RPMSG
	select IPC_SERVICE_STATIC_VRINGS
	select OPENAMP

config IPC_SERVICE_BACKEND_ICMSG
	bool "ICMSG backend with SPSC packet buffer"
	default y
	depends on MBOX
	depends on DT_HAS_ZEPHYR_IPC_ICMSG_ENABLED
	select IPC_SERVICE_ICMSG
	help
	  Chosing this backend results in single endpoint implementation based
	  on circular packet buffer.

config IPC_SERVICE_BACKEND_ICMSG_ME_INITIATOR
	bool "ICMSG backend with multi-endpoint support in initiator role"
	default y
	depends on MBOX
	depends on DT_HAS_ZEPHYR_IPC_ICMSG_ME_INITIATOR_ENABLED
	select IPC_SERVICE_ICMSG_ME
	help
	  Chosing this backend results in multi endpoint implementation based
	  on circular packet buffer. This enables enpoint discovery initiator
	  role.

config IPC_SERVICE_BACKEND_ICMSG_ME_FOLLOWER
	bool "ICMSG backend with multi-endpoint support in follower role"
	default y
	depends on MBOX
	depends on DT_HAS_ZEPHYR_IPC_ICMSG_ME_FOLLOWER_ENABLED
	select IPC_SERVICE_ICMSG_ME
	help
	  Chosing this backend results in multi endpoint implementation based
	  on circular packet buffer. This enables enpoint discovery follower
	  role.

config IPC_SERVICE_BACKEND_MPSC
	bool "MPSC backend with Shared MPSC packet buffer"
	default y
	select SHMPSC_PBUF
	select SYS_HASH_FUNC32
	depends on MBOX
	depends on DT_HAS_ZEPHYR_IPC_MPSC_ENABLED

if IPC_SERVICE_BACKEND_MPSC

config IPC_SERVICE_BACKEND_MPSC_EP_MAX
	int "Number of supported endpoints"
	default 8

choice IPC_SERVICE_BACKEND_MPSC_MODE
	prompt "Operation mode"
	default IPC_SERVICE_BACKEND_MPSC_THREAD if MULTITHREADING
	default IPC_SERVICE_BACKEND_MPSC_IRQ if !MULTITHREADING

config IPC_SERVICE_BACKEND_MPSC_THREAD
	bool "Own thread"
	depends on MULTITHREADING

config IPC_SERVICE_BACKEND_MPSC_SYS_WORKQ
	bool "System workqueue"
	depends on MULTITHREADING

config IPC_SERVICE_BACKEND_MPSC_IRQ
	bool "Interrupt context"

endchoice

config IPC_SERVICE_BACKEND_MPSC_STACK_SIZE
	int "Stack size"
	depends on IPC_SERVICE_BACKEND_MPSC_THREAD
	default 1024

config IPC_SERVICE_BACKEND_MPSC_PRIO
	int "Thread priority"
	depends on IPC_SERVICE_BACKEND_MPSC_THREAD
	default 0

config IPC_SERVICE_BACKEND_MPSC_NO_COPY
	bool "TX No copy"

endif # IPC_SERVICE_BACKEND_MPSC

rsource "Kconfig.icmsg_me"
rsource "Kconfig.icbmsg"
rsource "Kconfig.rpmsg"
```

## tests/boards/nrf/ppi/testcase.yaml
```yaml
common:
  tags: drivers
  harness: ztest
tests:
  boards.nrf.ppi:
    platform_allow:
      - nrf54h20dk/nrf54h20/cpuapp
      - nrf54h20dk/nrf54h20/cpurad
      - nrf54l15dk/nrf54l15/cpuapp
      - nrf5340dk/nrf5340/cpuapp
    integration_platforms:
      - nrf54l15dk/nrf54l15/cpuapp
      - nrf54h20dk/nrf54h20/cpuapp
```

## tests/drivers/dma/nrf_mvdma/testcase.yaml
```yaml
tests:
  drivers.dma.nrf_mvdma:
    tags:
      - drivers
      - dma
    harness: ztest
    platform_allow:
      - nrf54h20dk/nrf54h20/cpuapp
    integration_platforms:
      - nrf54h20dk/nrf54h20/cpuapp
```

## tests/subsys/ipc/ipc_service_api/testcase.yaml
```yaml
common:
  sysbuild: true
  tags:
    - ipc
  harness: ztest
  timeout: 60

tests:
  tests.ipc.ipc_service_api.icmsg:
    platform_allow:
      - nrf5340bsim/nrf5340/cpuapp
      - nrf54l15dk/nrf54l15/cpuapp
      - nrf54h20dk/nrf54h20/cpuapp
    integration_platforms:
      - nrf5340bsim/nrf5340/cpuapp
      - nrf54l15dk/nrf54l15/cpuapp
      - nrf54h20dk/nrf54h20/cpuapp
    extra_args:
      - FILE_SUFFIX=icmsg
      - remote_FILE_SUFFIX=icmsg
      - remote_CONFIG_IPC_SERVICE_BACKEND_ICMSG=y
      - remote_CONFIG_MBOX=y
    extra_configs:
      - CONFIG_IPC_SERVICE_BACKEND_ICMSG=y
      - CONFIG_MBOX=y
      - CONFIG_IPC_SERVICE_BACKEND_ICMSG_WQ_PRIORITY=-3
      - CONFIG_SYSTEM_WORKQUEUE_PRIORITY=-3
      - CONFIG_ZTEST_THREAD_PRIORITY=10
      - CONFIG_IPC_SERVICE_API_TEST_DEREGISTER=y
  tests.ipc.ipc_service_api.icbmsg:
    platform_allow:
      - nrf5340bsim/nrf5340/cpuapp
      - nrf5340dk/nrf5340/cpuapp
      - nrf54l15dk/nrf54l15/cpuapp
      - nrf54h20dk/nrf54h20/cpuapp
    integration_platforms:
      - nrf5340bsim/nrf5340/cpuapp
      - nrf54l15dk/nrf54l15/cpuapp
      - nrf54h20dk/nrf54h20/cpuapp
    #required_snippets:
    #  - nordic-log-stm
    extra_args:
      - FILE_SUFFIX=icbmsg
      - remote_FILE_SUFFIX=icbmsg
      - remote_CONFIG_IPC_SERVICE_BACKEND_ICBMSG_DEINIT=y
    extra_configs:
      - CONFIG_IPC_SERVICE_BACKEND_ICBMSG_DEINIT=y
      - CONFIG_IPC_SERVICE_API_TEST_DEREGISTER=y
      - CONFIG_IPC_SERVICE_API_TEST_CLOSE_BACKEND=y
      - CONFIG_IPC_SERVICE_API_TEST_SEND_FROM_ISR=y
  tests.ipc.ipc_service_api.static_vrings:
    platform_allow:
      - nrf5340dk/nrf5340/cpuapp
      - nrf5340bsim/nrf5340/cpuapp
    integration_platforms:
      - nrf5340dk/nrf5340/cpuapp
      - nrf5340bsim/nrf5340/cpuapp
    extra_args:
      - FILE_SUFFIX=static_vrings
      - remote_FILE_SUFFIX=static_vrings
    extra_configs:
      - CONFIG_IPC_SERVICE_API_TEST_DEREGISTER=y
      - CONFIG_IPC_SERVICE_API_TEST_CLOSE_BACKEND=y
  tests.ipc.ipc_service_api.icmsg.cpuppr:
    platform_allow:
      - nrf54h20dk/nrf54h20/cpuapp
    integration_platforms:
      - nrf54h20dk/nrf54h20/cpuapp
    extra_args:
      - FILE_SUFFIX=icmsg_cpuppr
      - remote_FILE_SUFFIX=icmsg
      - remote_CONFIG_IPC_SERVICE_BACKEND_ICMSG=y
      - remote_CONFIG_MBOX=y
      - remote_CONFIG_LOG=n
      - SB_CONF_FILE=sysbuild_icmsg_cpuppr.conf
      - ipc_service_api_SNIPPET=nordic-ppr
    extra_configs:
      - CONFIG_IPC_SERVICE_BACKEND_ICMSG=y
      - CONFIG_MBOX=y
      - CONFIG_IPC_SERVICE_BACKEND_ICMSG_WQ_PRIORITY=-3
      - CONFIG_SYSTEM_WORKQUEUE_PRIORITY=-3
      - CONFIG_ZTEST_THREAD_PRIORITY=10
      - CONFIG_IPC_SERVICE_API_TEST_DEREGISTER=y
  tests.ipc.ipc_service_api.icbmsg.cpuppr:
    platform_allow:
      - nrf54h20dk/nrf54h20/cpuapp
    integration_platforms:
      - nrf54h20dk/nrf54h20/cpuapp
    extra_args:
      - FILE_SUFFIX=icbmsg_cpuppr
      - remote_FILE_SUFFIX=icbmsg
      - remote_CONFIG_MBOX=y
      - remote_CONFIG_LOG=n
      - remote_CONFIG_IPC_SERVICE_BACKEND_ICBMSG_DEINIT=y
      - SB_CONF_FILE=sysbuild_icbmsg_cpuppr.conf
      - ipc_service_api_SNIPPET=nordic-ppr
    extra_configs:
      - CONFIG_MBOX=y
      - CONFIG_IPC_SERVICE_BACKEND_ICBMSG_DEINIT=y
      - CONFIG_IPC_SERVICE_API_TEST_DEREGISTER=y
      - CONFIG_IPC_SERVICE_API_TEST_CLOSE_BACKEND=y
      - CONFIG_IPC_SERVICE_API_TEST_SEND_FROM_ISR=y
  tests.ipc.ipc_service_api.icmsg.cpuflpr:
    platform_allow:
      - nrf54h20dk/nrf54h20/cpuapp
    integration_platforms:
      - nrf54h20dk/nrf54h20/cpuapp
    extra_args:
      - FILE_SUFFIX=icmsg_cpuflpr
      - remote_FILE_SUFFIX=icmsg
      - remote_CONFIG_IPC_SERVICE_BACKEND_ICMSG=y
      - remote_CONFIG_MBOX=y
      - remote_CONFIG_LOG=n
      - SB_CONF_FILE=sysbuild_icmsg_cpuflpr.conf
      - ipc_service_api_SNIPPET=nordic-flpr
    extra_configs:
      - CONFIG_IPC_SERVICE_BACKEND_ICMSG=y
      - CONFIG_MBOX=y
      - CONFIG_IPC_SERVICE_BACKEND_ICMSG_WQ_PRIORITY=-3
      - CONFIG_SYSTEM_WORKQUEUE_PRIORITY=-3
      - CONFIG_ZTEST_THREAD_PRIORITY=10
      - CONFIG_IPC_SERVICE_API_TEST_DEREGISTER=y
  tests.ipc.ipc_service_api.icbmsg.cpuflpr:
    platform_allow:
      - nrf54h20dk/nrf54h20/cpuapp
    integration_platforms:
      - nrf54h20dk/nrf54h20/cpuapp
    extra_args:
      - FILE_SUFFIX=icbmsg_cpuflpr
      - remote_FILE_SUFFIX=icbmsg
      - remote_CONFIG_MBOX=y
      - remote_CONFIG_IPC_SERVICE_BACKEND_ICBMSG_DEINIT=y
      - SB_CONF_FILE=sysbuild_icbmsg_cpuflpr.conf
    required_snippets:
      - nordic-log-stm
      - nordic-flpr
    extra_configs:
      - CONFIG_MBOX=y
      - CONFIG_IPC_SERVICE_BACKEND_ICBMSG_DEINIT=y
      - CONFIG_IPC_SERVICE_API_TEST_DEREGISTER=y
      - CONFIG_IPC_SERVICE_API_TEST_CLOSE_BACKEND=y
      - CONFIG_IPC_SERVICE_API_TEST_SEND_FROM_ISR=y
```

## tests/subsys/ipc/shmpsc_pbuf/shared/testcase.yaml
```yaml
sample:
  name: MPSC Packet Buffer test using shared memory
common:
  timeout: 30
  sysbuild: true
  tags: ipc
tests:
  ipc.lib.shmpsc_pbuf_shared:
    platform_allow:
      - nrf54h20dk/nrf54h20/cpuapp
    integration_platforms:
      - nrf54h20dk/nrf54h20/cpuapp
  ipc.lib.shmpsc_pbuf_shared.nrf54l15:
    platform_allow:
      - nrf54l15dk/nrf54l15/cpuapp
    integration_platforms:
      - nrf54l15dk/nrf54l15/cpuapp
    extra_args: shared_SNIPPET=nordic-flpr
```

## tests/subsys/ipc/shmpsc_pbuf/single_core/testcase.yaml
```yaml
tests:
  ipc.lib.shmpsc_pbuf:
    tags: shmpsc_pbuf
    platform_allow:
      - qemu_arc/qemu_arc_em
      - qemu_arc/qemu_arc_hs
      - qemu_cortex_a53
      - qemu_cortex_m0
      - qemu_cortex_m3
      - qemu_cortex_r5
      - qemu_leon3
      - qemu_nios2
      - qemu_riscv32
      - qemu_riscv64
      - qemu_x86
      - qemu_x86_64
      - qemu_xtensa/dc233c
      - native_posix
      - native_sim
    integration_platforms:
      - native_sim

  ipc.lib.shmpsc_pbuf.concurrent:
    tags: shmpsc_pbuf
    platform_allow:
      - qemu_x86
    extra_configs:
      - CONFIG_SYS_CLOCK_TICKS_PER_SEC=20000
    timeout: 120
    integration_platforms:
      - qemu_x86
```

## tests/subsys/shell/remote_shell/testcase.yaml
```yaml
common:
  sysbuild: true
  tags:
    - shell
    - ipc
  harness: ztest
tests:
  shell.remote_shell:
    platform_allow:
      - nrf5340dk/nrf5340/cpuapp
      - nrf5340bsim/nrf5340/cpuapp
      - nrf54h20dk/nrf54h20/cpuapp
      - nrf54l15dk/nrf54l15/cpuapp
    integration_platforms:
      - nrf5340bsim/nrf5340/cpuapp
      - nrf54l15dk/nrf54l15/cpuapp
  shell.remote_shell.no_multithreading:
    platform_allow:
      - nrf5340dk/nrf5340/cpuapp
      - nrf54l15dk/nrf54l15/cpuapp
    integration_platforms:
      - nrf54l15dk/nrf54l15/cpuapp
    extra_args:
      - remote_CONFIG_MULTITHREADING=n
```
