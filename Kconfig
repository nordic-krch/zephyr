## Kconfig
```kconfig
# General configuration options

# Copyright (c) 2014-2015 Wind River Systems, Inc.
# SPDX-License-Identifier: Apache-2.0

mainmenu "Application Configuration"

source "modules/Kconfig.nordic"

menu "Hic Sunt Leones"

source "Kconfig.zephyr"

endmenu
```

## drivers/sensor/sensor_monitor/Kconfig
```kconfig
# Copyright (c) 2019, Nordic Semiconductor ASA
# SPDX-License-Identifier: Apache-2.0

config SENSOR_MONITOR
	bool "Sensor monitor"
	help
	  Enable sensor monitor. Module manages periodical sensor's channel
	  sampling. User function gets each sample and decides if it should
	  trigger an action. Action can also be triggered periodically even
	  if sample level did not lead to the trigger.
```

## samples/bluetooth/peripheral_hr/boards/nrf52840dk_nrf52840.conf
```kconfig
CONFIG_NRF_LPUART_UARTE_INSTANCE=1
CONFIG_NRF_LPUART_TXCTRL_PIN=35
CONFIG_NRF_LPUART_RXCTRL_PIN=36
CONFIG_UART_1_ASYNC=y
CONFIG_UART_1_NRF_HW_ASYNC=y
CONFIG_UART_1_NRF_HW_ASYNC_TIMER=2
CONFIG_NRFX_TIMER2=y
```

## samples/bluetooth/peripheral_hr/boards/nrf9160dk_nrf9160.conf
```kconfig
CONFIG_NRF_LPUART_UARTE_INSTANCE=2

CONFIG_NRF_LPUART_TXCTRL_PIN=21
CONFIG_NRF_LPUART_RXCTRL_PIN=19

CONFIG_UART_2_ASYNC=y
CONFIG_UART_2_NRF_HW_ASYNC=y
CONFIG_UART_2_NRF_HW_ASYNC_TIMER=1
CONFIG_NRFX_TIMER1=y

CONFIG_HW_CC310=n
```

## samples/bluetooth/peripheral_hr/boards/nrf9160dk_nrf9160_ext_nrf52.conf
```kconfig
CONFIG_NRF_LPUART_TXCTRL_PIN=20
CONFIG_NRF_LPUART_RXCTRL_PIN=30
CONFIG_BOARD_NRF52840_GPIO_RESET_PIN=16

CONFIG_NRF_LPUART_UARTE_INSTANCE=2

CONFIG_UART_2_ASYNC=y
CONFIG_UART_2_NRF_HW_ASYNC=y
CONFIG_UART_2_NRF_HW_ASYNC_TIMER=1
CONFIG_NRFX_TIMER1=y

CONFIG_HW_CC310=n
```

## subsys/logging/Kconfig.frontends
```kconfig
# Copyright (c) 2022 Nordic Semiconductor ASA
# SPDX-License-Identifier: Apache-2.0

menu "Frontends"

config LOG_FRONTEND_DICT
	bool "Dictionary based frontend"
	select MPSC_PBUF
	select LOG_FRONTEND_OPT_API
	imply LOG_FMT_SECTION
	imply LOG_FMT_SECTION_STRIP

if LOG_FRONTEND_DICT

config LOG_FRONTEND_DICT_ASYNC
	bool "Asynchronous sink"

config LOG_FRONTEND_DICT_COBS
	bool "Use COBS"
	select COBS

config LOG_FRONTEND_DICT_BUF_SIZE
	int "Buffer size"
	default 1024
	help
	  Number of bytes dedicated for buffering data

endif

config LOG_FRONTEND_DICT_UART
	bool "UART dictionary frontend"
	select LOG_DICTIONARY_DB
	select MPSC_PBUF
	depends on UART_ASYNC_API || UART_INTERRUPT_DRIVEN
	imply LOG_FMT_SECTION
	imply LOG_FMT_SECTION_STRIP
	help
	  Frontend sends data in binary dictionary mode.

if LOG_FRONTEND_DICT_UART

config LOG_FRONTEND_DICT_UART_BUFFER_SIZE
	int "Buffer size"
	default 1024
	help
	  Number of bytes dedicated for buffering data

config LOG_FRONTEND_DICT_UART_DROPPED_NOTIFY_PERIOD
	int "Dropped notification period"
	default 500
	help
	  Determines how often a report about dropped messages is printed. Given
	  in milliseconds.

endif
endmenu
```

## subsys/logging/Kconfig.mode
```kconfig
# Copyright (c) 2021 Nordic Semiconductor ASA
# SPDX-License-Identifier: Apache-2.0

choice
	prompt "Mode"
	default LOG_MINIMAL if TEST_LOGGING_DEFAULTS
	default LOG_DEFERRED

config LOG_DEFERRED
	bool "Deferred logging"

config LOG2
	bool "Deferred logging v2"
	select MPSC_PBUF

config LOG_SYNC
	bool "Synchronous"
	help
	  When enabled log is processed in the context of the call. It impacts
	  performance of the system since time consuming operations are
	  performed in the context of the log entry (e.g. high priority
	  interrupt).Logger backends must support exclusive access to work
	  flawlessly in that mode because one log operation can be interrupted
	  by another one in the higher priority context.


config LOG_MINIMAL
	bool "Minimal-footprint"
	imply PRINTK
	help
	  Enable minimal logging implementation. This has very little footprint
	  overhead on top of the printk() implementation for standard
	  logging macros. Hexdump macros are also supported, with a small
	  amount of code pulled in if used. Build time filtering is supported,
	  but not runtime filtering. There are no timestamps, prefixes,
	  colors, or asynchronous logging, and all messages are simply
	  sent to printk().

config LOG_FRONTEND
	bool "Frontend"
	help
	  When enabled, logs are redirected to a custom frontend instead
	  of being processed by the logger.

endchoice

config LOG_IMMEDIATE
	bool
	default y if LOG_FRONTEND || LOG_SYNC
```

## tests/lib/icmsg/testcase.yaml
```yaml
tests:
  libraries.icmsg:
    integration_platforms:
      - nrf5340dk_nrf5340_cpuapp
```

## tests/subsys/logging/log_frontend_dict/testcase.yaml
```yaml
common:
  platform_type:
    - qemu
  tags:
    - logging
  integration_platforms:
    - qemu_x86
tests:
  logging.log_frontend_dict:
    integration_platforms:
      - qemu_x86
  logging.log_frontend_dict.async:
    extra_configs:
      - CONFIG_LOG_FRONTEND_DICT_ASYNC=y
```

## tests/subsys/logging/log_item/Kconfig
```kconfig
config LOG_CORE2
	bool
	select RING_BUFFER
	default y

config LOG_BUFFER_SIZE
	int
	default 512

config LOG_MODE_OVERFLOW
	bool "Overflow"

source "Kconfig.zephyr"
```
