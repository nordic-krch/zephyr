## CMakeLists.txt
```
cmake_minimum_required(VERSION 3.8.2)

# This application has its own Kconfig options.
set(KCONFIG_ROOT ${CMAKE_CURRENT_SOURCE_DIR}/Kconfig)

# CONF_FILE is prj.conf, plus (in addition to, not or)
# boards/${BOARD}.conf, if it exists. The board-specific file needs to
# be an absolute path; otherwise, the behavior of EXISTS is not
# well-defined.
set(CONF_FILE prj.conf)
if(EXISTS ${CMAKE_CURRENT_SOURCE_DIR}/boards/${BOARD}.conf)
  set(CONF_FILE ${CONF_FILE} " boards/${BOARD}.conf")
endif()

# Mandatory Zephyr boilerplate.
include($ENV{ZEPHYR_BASE}/cmake/app/boilerplate.cmake NO_POLICY_SCOPE)
project(NONE)

target_sources(app PRIVATE src/product_id.c)

# Application build configuration.
target_include_directories(app PRIVATE $ENV{ZEPHYR_BASE}/tests/include)
target_include_directories(app PRIVATE ${CMAKE_CURRENT_SOURCE_DIR}/src/lib)

target_sources(app PRIVATE src/main.c)
target_sources(app PRIVATE src/app_work_queue.c)
target_sources(app PRIVATE src/elce2018_mqtt.c)
target_sources(app PRIVATE src/${BOARD}.c)

target_sources_ifdef(CONFIG_BT               app PRIVATE src/bluetooth.c)
```

## prj.conf
```kconfig
CONFIG_BOOT_BANNER=y
CONFIG_REBOOT=y
CONFIG_FLASH=y
CONFIG_NETWORKING=y

# Network
CONFIG_NET_TCP=y
CONFIG_NET_MGMT=y
CONFIG_NET_MGMT_EVENT=y
CONFIG_NET_CONTEXT_NET_PKT_POOL=y
CONFIG_NET_RX_STACK_SIZE=2048
CONFIG_NET_PKT_RX_COUNT=10
CONFIG_NET_PKT_TX_COUNT=10
CONFIG_NET_BUF_RX_COUNT=15
CONFIG_NET_BUF_TX_COUNT=15
CONFIG_NET_BUF_DATA_SIZE=256
CONFIG_NET_TCP_INIT_RETRANSMISSION_TIMEOUT=2000

# MQTT
# Select MQTT_LIB manually for now to send temp data
CONFIG_MQTT_LIB=y
# This value was chosen arbitrarily
CONFIG_MQTT_MSG_MAX_SIZE=255
# add 2 more message allowance to the netbuf pool for MQTT
CONFIG_MQTT_ADDITIONAL_BUFFER_CTR=2
CONFIG_MQTT_SUBSCRIBE_MAX_TOPICS=2
# Add JSON support for formatting MQTT messages.
CONFIG_JSON_LIBRARY=y

# NET APP
CONFIG_NET_APP=y
CONFIG_NET_APP_CLIENT=y
CONFIG_NET_CONFIG_SETTINGS=y

# Logging
CONFIG_LOG=y
CONFIG_ELCE2018_LOG_LEVEL_DBG=y

# Bluetooth (when enabled) debug
#CONFIG_BT_DEBUG_LOG=y
#CONFIG_BT_DEBUG_HCI_DRIVER=y

# Debug helpers
#CONFIG_NET_LOG=y
#CONFIG_NET_APP_LOG_LEVEL_DBG=y
#CONFIG_NET_CORE_LOG_LEVEL_DBG=y
#CONFIG_NET_IF_LOG_LEVEL_DBG=y
#CONFIG_NET_UTILS_LOG_LEVEL_DBG=y
#CONFIG_NET_CONTEXT_LOG_LEVEL_DBG=y
#CONFIG_NET_PKT_LOG_LEVEL_DBG=y
#CONFIG_NET_CONN_LOG_LEVEL_DBG=y
#CONFIG_NET_ROUTE_LOG_LEVEL_DBG=y
#CONFIG_NET_IPV4_LOG_LEVEL_DBG=y
#CONFIG_NET_IPV6_LOG_LEVEL_DBG=y
#CONFIG_NET_ICMPV6_LOG_LEVEL_DBG=y
#CONFIG_NET_IPV6_NBR_CACHE_LOG_LEVEL_DBG=y
#CONFIG_NET_6LO_LOG_LEVEL_DBG=y
#CONFIG_NET_TCP_LOG_LEVEL_DBG=y
#CONFIG_NET_L2_ETHERNET_LOG_LEVEL_DBG=y
#CONFIG_NET_L2_BT_LOG_LEVEL_DBG=y
#CONFIG_INIT_STACKS=y
#CONFIG_STACK_USAGE=y

CONFIG_PRINTK=y
CONFIG_SERIAL=y
CONFIG_CONSOLE=y
CONFIG_STDOUT_CONSOLE=y

CONFIG_I2C=y
CONFIG_GPIO=y
CONFIG_SENSOR=y

CONFIG_APDS9960=y

CONFIG_HDC1008=y

CONFIG_SPI=y
CONFIG_SPI_ASYNC=y

CONFIG_HEAP_MEM_POOL_SIZE=16384
CONFIG_DISPLAY=y
CONFIG_SSD1673=y

CONFIG_CHARACTER_FRAMEBUFFER=y
```

## src/main.c
```c
/*
 * Copyright (c) 2017 Linaro Limited
 * Copyright (c) 2018 Foundries.io
 *
 * SPDX-License-Identifier: Apache-2.0
 */

#define LOG_MODULE_NAME elce2018_main
#define LOG_LEVEL CONFIG_ELCE2018_LOG_LEVEL

#include <logging/log.h>
LOG_MODULE_REGISTER(LOG_MODULE_NAME);

#include "app_work_queue.h"
#include "product_id.h"
#include "elce2018_mqtt.h"
#include "board.h"

void main(void)
{
	app_wq_init();
	(void)board_init();

	LOG_INF("ELCE 2018 Cloud Connected Hackathon application");
	LOG_INF("Board: %s, DeviceID: %x",
		product_id_get()->name, product_id_get()->number);

	LOG_INF("Running Built in Self Test (BIST)");

	LOG_INF("Initializing MQTT service\n");
	if (elce2018_mqtt_start()) {
		LOG_ERR("MQTT init failed; aborting!");
		return;
	}

	/*
	 * From this point on, just handle work.
	 */
	app_wq_run();
}
```

## src/elce2018_mqtt.c
```c
/*
 * Copyright (c) 2017 Linaro Limited
 * Copyright (c) 2017-2018 Foundries.io Ltd
 *
 * SPDX-License-Identifier: Apache-2.0
 */

/*
 * Much of the initial code here was pulled from
 * samples/net/mqtt_publisher
 */

#define LOG_MODULE_NAME elce2018_mqtt_temp
#define LOG_LEVEL CONFIG_ELCE2018_LOG_LEVEL

#include <logging/log.h>
LOG_MODULE_REGISTER(LOG_MODULE_NAME);

#include <errno.h>
#include <stdio.h>
#include <string.h>
#include <stdarg.h>

#include <device.h>
#include <json.h>
#include <logging/log_ctrl.h>
#include <misc/reboot.h>
#include <net/net_app.h>
#include <net/net_event.h>
#include <net/net_if.h>
#include <net/net_mgmt.h>
#include <net/mqtt.h>
#include <sensor.h>
#include <toolchain.h>
#include <zephyr.h>

#include "product_id.h"
#include "app_work_queue.h"
#include "elce2018_mqtt.h"
#ifdef CONFIG_NET_L2_BT
#include "bluetooth.h"
#endif

#include <shell/shell.h>
#include "board.h"

#define MAX_FAILURES		5
#define NUM_TEST_RESULTS	5
#define AMB_TEMP_DEV		"ambient-temp"
#define DIE_TEMP_DEV		"die-temp"
#define MQTT_PORT		1883
#define MQTT_USERNAME		CONFIG_ELCE2018_MQTT_USERNAME
#define MQTT_PASSWORD		CONFIG_ELCE2018_MQTT_PASSWORD
#define MQTT_CONNECT_TRIES	10
#define APP_CONNECT_TRIES	10
#define CONNECT_WAIT_TIMEOUT	K_MSEC(500)
#define PUBLISH_DELAY_TIME	K_SECONDS(3)
#define MQTT_NET_TIMEOUT	K_MSEC(300)

/* Network configuration checks */
#if defined(CONFIG_NET_IPV6)
BUILD_ASSERT_MSG(sizeof(CONFIG_NET_CONFIG_PEER_IPV6_ADDR) > 1,
		"CONFIG_NET_CONFIG_PEER_IPV6_ADDR must be defined in boards/$(BOARD)-local.conf");
#define MQTT_HELPER_SERVER_ADDR    CONFIG_NET_CONFIG_PEER_IPV6_ADDR
#elif defined(CONFIG_NET_IPV4)
#if !defined(CONFIG_NET_DHCPV4)
BUILD_ASSERT_MSG(sizeof(CONFIG_NET_CONFIG_MY_IPV4_ADDR) > 1,
		"DHCPv4 must be enabled, or CONFIG_NET_CONFIG_MY_IPV4_ADDR must be defined, in boards/$(BOARD)-local.conf");
#endif
BUILD_ASSERT_MSG(sizeof(CONFIG_NET_CONFIG_PEER_IPV4_ADDR) > 1,
		"CONFIG_NET_CONFIG_PEER_IPV4_ADDR must be defined in boards/$(BOARD)-local.conf");
#define MQTT_HELPER_SERVER_ADDR    CONFIG_NET_CONFIG_PEER_IPV4_ADDR
#endif

/*
 * All possible sources of data. Add your own extensions for the hackathon!
 *
 * This (or a subset of it) is what gets serialized into JSON.
 */
struct mqtt_sensor_data {
	int amb_temp;
	int die_temp;
	char * msg;
};

#define MAX_SENSOR_DATA 2

/*
 * Main context object.
 */
struct elce2018_mqtt_data {
	/* MQTT plumbing. */
	u8_t mqtt_client_id[30];	/* Device-unique identifier */
	u8_t mqtt_password[20];	/* MQTT password */
	u8_t mqtt_topic[255];		/* Buffer for topic names */
	u8_t sub_topic[255];		/* Buffer for topic names */
	u8_t mqtt_message[1024];	/* Buffer for message data */
	struct mqtt_ctx mqtt;
	struct mqtt_connect_msg connect_msg;
	struct mqtt_publish_msg pub_msg;
	struct k_sem mqtt_wait_sem;
	struct k_delayed_work mqtt_work;
	int failures;

	/* Sensor data sources. Extend for the hackathon! */
	struct device *amb_dev;
	struct device *die_dev;
	struct mqtt_sensor_data sensor_data;
	/*
	 * This gets built up at runtime depending on the devices that
	 * were discovered.
	 */
	struct json_obj_descr sensor_json_descr[MAX_SENSOR_DATA];
	int sensor_num_sources;
};

/*
 * JSON descriptor objects. Extend for the hackathon!
 */
static const struct json_obj_descr json_amb_temp_descr =
	JSON_OBJ_DESCR_PRIM(struct mqtt_sensor_data, amb_temp, JSON_TOK_NUMBER);

static const struct json_obj_descr json_die_temp_descr =
	JSON_OBJ_DESCR_PRIM(struct mqtt_sensor_data, die_temp,
			    JSON_TOK_NUMBER);

static const struct json_obj_descr json_chat_descr =
	JSON_OBJ_DESCR_PRIM(struct mqtt_sensor_data, msg,
			    JSON_TOK_STRING);

static struct elce2018_mqtt_data temp_data;

#if defined(CONFIG_NET_MGMT_EVENT)
static struct net_mgmt_event_callback net_mgmt_cb;
#endif

#if defined(CONFIG_NET_CONTEXT_NET_PKT_POOL)
NET_PKT_TX_SLAB_DEFINE(mqtt_client_tx, 5);
NET_PKT_DATA_POOL_DEFINE(mqtt_client_data, 15);

static struct k_mem_slab *tx_slab(void)
{
	return &mqtt_client_tx;
}

static struct net_buf_pool *data_pool(void)
{
	return &mqtt_client_data;
}
#else
#if defined(CONFIG_NET_L2_BT)
#error "TCP connections over Bluetooth need CONFIG_NET_CONTEXT_NET_PKT_POOL "\
	"defined."
#endif /* CONFIG_NET_L2_BT */

#define tx_slab NULL
#define data_pool NULL
#endif /* CONFIG_NET_CONTEXT_NET_PKT_POOL */

static void elce2018_mqtt_reboot_check(struct elce2018_mqtt_data *data, int result)
{
	if (result) {
		if (++data->failures >= MAX_FAILURES) {
			LOG_ERR("Too many MQTT errors, rebooting!");
#ifdef CONFIG_NET_L2_BT
			bt_network_disable();
#endif
			LOG_PANIC();
			sys_reboot(0);
		}
	} else {
		data->failures = 0;
	}
}

/*
 * Sensor data handling
 */

static int read_temperature(struct device *temp_dev,
			    enum sensor_channel temp_channel,
			    struct sensor_value *temp_val)
{
	__unused const char *name = temp_dev->config->name;
	int ret;

	ret = sensor_sample_fetch(temp_dev);
	if (ret) {
		LOG_ERR("%s: I/O error: %d", name, ret);
		return ret;
	}

	ret = sensor_channel_get(temp_dev, temp_channel, temp_val);
	if (ret) {
		LOG_ERR("%s: can't get data: %d", name, ret);
		return ret;
	}

	LOG_DBG("%s: read %d.%d C", name, temp_val->val1, temp_val->val2);
	return 0;
}


/*
 * MQTT callbacks and other plumbing.
 */

static inline struct elce2018_mqtt_data *mqtt_to_data(struct mqtt_ctx *mqtt)
{
	return CONTAINER_OF(mqtt, struct elce2018_mqtt_data, mqtt);
}

static inline int elce2018_mqtt_wait(struct elce2018_mqtt_data *data, s32_t timeout)
{
	return k_sem_take(&data->mqtt_wait_sem, timeout);
}

static void elce2018_mqtt_connect_cb(struct mqtt_ctx *mqtt)
{
	LOG_DBG("connected");
	k_sem_give(&mqtt_to_data(mqtt)->mqtt_wait_sem);
}

static void elce2018_mqtt_disconnect_cb(struct mqtt_ctx *mqtt)
{
	LOG_DBG("disconnected");
	k_sem_give(&mqtt_to_data(mqtt)->mqtt_wait_sem);
}

static void elce2018_mqtt_malformed_cb(struct mqtt_ctx *mqtt, u16_t pkt_type)
{
	LOG_DBG("malformed data, type 0x%x", pkt_type);
}

/*
 * Try to connect to the MQTT broker. The helper context must have
 * properly initialized mqtt and connect_msg fields.
 */
static int elce2018_mqtt_connect(struct elce2018_mqtt_data *data)
{
	struct mqtt_ctx *mqtt = &data->mqtt;
	struct mqtt_connect_msg *msg = &data->connect_msg;
	int i = 0;
	int ret = 0;

	for (i = 0; i < MQTT_CONNECT_TRIES; i++) {
		ret = mqtt_connect(mqtt);
		if (!ret) {
			break;
		}
	}

	if (ret) {
		return ret;
	}

	for (i = 0; i < APP_CONNECT_TRIES; i++) {
		ret = mqtt_tx_connect(mqtt, msg);
		if (ret) {
			LOG_ERR("mqtt_tx_connect: %d", ret);
			continue;
		}
		ret = elce2018_mqtt_wait(data, CONNECT_WAIT_TIMEOUT);

		if (mqtt->connected) {
			return 0;
		}
	}

	mqtt_close(&data->mqtt);
	LOG_ERR("timed out");
	return -ETIMEDOUT;
}

static int publish_chat(struct elce2018_mqtt_data *data, char * str)
{
	struct mqtt_publish_msg *pub_msg = &data->pub_msg;
	int ret;

	/* Fill out the MQTT publication, and ship it.
	 *
	 * IMPORTANT: don't increase the level of QoS here, even if
	 *            Zephyr claims to support it, until the Zephyr
	 *            MQTT stack can correctly parse multiple MQTT
	 *            packets within a single struct net_pkt.
	 *
	 * Working around that issue implies never receiving multiple
	 * MQTT packets in the same net_pkt.
	 *
	 * Keep this at QoS 0 to avoid receiving PUBACK or PUBREC in
	 * response to this message. Since this app is a publisher
	 * only, the remaining possible incoming messages are CONNACK
	 * and PINGRESP (depending on nonzero keep_alive). Those will
	 * never be transmitted at the same time, as we ought to wait
	 * for CONNACK before sending any PINGREQs.
	 */
	pub_msg->msg = str;
	pub_msg->msg_len = strlen(pub_msg->msg);
	pub_msg->qos = MQTT_QoS0;
	pub_msg->topic = data->mqtt_topic;
	pub_msg->topic_len = strlen(pub_msg->topic);

	LOG_DBG("topic: %s", data->pub_msg.topic);
	LOG_DBG("message: %s", data->pub_msg.msg);
	ret = mqtt_tx_publish(&data->mqtt, &data->pub_msg);
	if (ret) {
		LOG_ERR("publish failed: %d", ret);
	}

	return ret;
}
static int elce2018_mqtt_publish(struct elce2018_mqtt_data *data)
{
	struct mqtt_publish_msg *pub_msg = &data->pub_msg;
	int ret;

	/*
	 * Set up the topic and message contents. Extend for the hackathon!
	 */
	snprintk(data->mqtt_topic, sizeof(data->mqtt_topic),
		 "id/%s/sensor-data/json", data->mqtt_client_id);
	ret =  json_obj_encode_buf(data->sensor_json_descr,
				   data->sensor_num_sources,
				   &data->sensor_data,
				   data->mqtt_message,
				   sizeof(data->mqtt_message) - 1);
	if (ret) {
		LOG_ERR("json_obj_encode_buf: %d", ret);
		return ret;
	} else {
		LOG_DBG("json: %s", data->mqtt_message);
	}

	/* Fill out the MQTT publication, and ship it.
	 *
	 * IMPORTANT: don't increase the level of QoS here, even if
	 *            Zephyr claims to support it, until the Zephyr
	 *            MQTT stack can correctly parse multiple MQTT
	 *            packets within a single struct net_pkt.
	 *
	 * Working around that issue implies never receiving multiple
	 * MQTT packets in the same net_pkt.
	 *
	 * Keep this at QoS 0 to avoid receiving PUBACK or PUBREC in
	 * response to this message. Since this app is a publisher
	 * only, the remaining possible incoming messages are CONNACK
	 * and PINGRESP (depending on nonzero keep_alive). Those will
	 * never be transmitted at the same time, as we ought to wait
	 * for CONNACK before sending any PINGREQs.
	 */
	pub_msg->msg = data->mqtt_message;
	pub_msg->msg_len = strlen(pub_msg->msg);
	pub_msg->qos = MQTT_QoS0;
	pub_msg->topic = data->mqtt_topic;
	pub_msg->topic_len = strlen(pub_msg->topic);

	LOG_DBG("topic: %s", data->pub_msg.topic);
	LOG_DBG("message: %s", data->pub_msg.msg);
	ret = mqtt_tx_publish(&data->mqtt, &data->pub_msg);
	if (ret) {
		LOG_ERR("publish failed: %d", ret);
	}

	return ret;
}

static void elce2018_mqtt_try_to_publish(struct k_work *work)
{
	struct elce2018_mqtt_data *data =
		CONTAINER_OF(work, struct elce2018_mqtt_data, mqtt_work);
	struct sensor_value mcu_val;
	struct sensor_value die_val;
	int ret = 0;

	if (!data->mqtt.connected) {
		ret = elce2018_mqtt_connect(data);
		if (ret) {
			LOG_ERR("connection failed: %d", ret);
			goto out;
		}
	}

	/*
	 * Try to read temperature sensor values, and publish the
	 * whole number portion of temperatures that are read.
	 *
	 * Extend for the hackathon!
	 */
	if (data->amb_dev) {
		ret = read_temperature(data->amb_dev,
				       SENSOR_CHAN_AMBIENT_TEMP,
				       &mcu_val);
	}
	if (ret) {
		goto out;
	}
	if (data->die_dev) {
		ret = read_temperature(data->die_dev,
				       SENSOR_CHAN_DIE_TEMP,
				       &die_val);
	}
	if (ret) {
		goto out;
	}

	if (data->amb_dev) {
		data->sensor_data.amb_temp = mcu_val.val1;
	}
	if (data->die_dev) {
		data->sensor_data.die_temp = die_val.val1;
	}

	ret = elce2018_mqtt_publish(data);

 out:
	elce2018_mqtt_reboot_check(data, ret);
	//app_wq_submit_delayed(&data->mqtt_work, PUBLISH_DELAY_TIME);
}
static void elce2018_mqtt_try_to_publish_chat(struct k_work *work, char *str)
{
	struct elce2018_mqtt_data *data =
		CONTAINER_OF(work, struct elce2018_mqtt_data, mqtt_work);
	int ret = 0;

	if (!data->mqtt.connected) {
		ret = elce2018_mqtt_connect(data);
		if (ret) {
			LOG_ERR("connection failed: %d", ret);
			goto out;
		}
	}

	LOG_INF("Connected");

	ret = publish_chat(data, str);

 out:
	elce2018_mqtt_reboot_check(data, ret);
	//app_wq_submit_delayed(&data->mqtt_work, PUBLISH_DELAY_TIME);
}

/*
 * Initialization
 */

static int subscribed_cb(struct mqtt_ctx *ctx, u16_t pkt_id,
		 u8_t items, enum mqtt_qos qos[])
{
	LOG_DBG("Subscribed");
	return 0;
}

static int publish_rx_cb(struct mqtt_ctx *ctx, struct mqtt_publish_msg *msg,
		  u16_t pkt_id, enum mqtt_packet type)
{
	msg->msg[msg->msg_len] = '\0';
	LOG_INF("receive publication %s", msg->msg);
	return 0;
}

static int init_mqtt_plumbing(struct elce2018_mqtt_data *data)
{
	int ret;

	snprintk(data->mqtt_client_id, sizeof(data->mqtt_client_id), "%s-%08x",
		 CONFIG_BOARD, product_id_get()->number);
	if (!strcmp(MQTT_PASSWORD, "")) {
		snprintk(data->mqtt_password, sizeof(data->mqtt_password),
			 "%08x", product_id_get()->number);
	} else {
		snprintk(data->mqtt_password, sizeof(data->mqtt_password),
			 "%s", MQTT_PASSWORD);
	}

	data->mqtt.connect = elce2018_mqtt_connect_cb;
	data->mqtt.disconnect = elce2018_mqtt_disconnect_cb;
	data->mqtt.malformed = elce2018_mqtt_malformed_cb;
	data->mqtt.net_timeout = MQTT_NET_TIMEOUT;
	data->mqtt.peer_addr_str = MQTT_HELPER_SERVER_ADDR;
	data->mqtt.peer_port = MQTT_PORT;
	data->mqtt.subscribe = subscribed_cb;
	data->mqtt.publish_rx = publish_rx_cb;
	ret = mqtt_init(&data->mqtt, MQTT_APP_PUBLISHER_SUBSCRIBER);
	if (ret) {
		return ret;
	}

#if defined(CONFIG_NET_CONTEXT_NET_PKT_POOL)
	net_app_set_net_pkt_pool(&data->mqtt.net_app_ctx, tx_slab, data_pool);
#endif

	data->connect_msg.client_id = data->mqtt_client_id;
	data->connect_msg.client_id_len = strlen(data->connect_msg.client_id);
	data->connect_msg.keep_alive = 0;
	data->connect_msg.user_name = MQTT_USERNAME;
	data->connect_msg.user_name_len = strlen(data->connect_msg.user_name);
	data->connect_msg.password = data->mqtt_client_id;
	data->connect_msg.password_len = strlen(data->connect_msg.password);
	data->connect_msg.clean_session = 1;

	k_sem_init(&data->mqtt_wait_sem, 0, 1);
	k_delayed_work_init(&data->mqtt_work, elce2018_mqtt_try_to_publish);

	data->failures = 0;

	return 0;
}

/*
 * Initialize sources of sensor data. Extend for the hackathon!
 */
static int init_sensor_sources(struct elce2018_mqtt_data *data)
{
	int num_sources = 0;
	data->amb_dev = device_get_binding(AMB_TEMP_DEV);
	data->die_dev = device_get_binding(DIE_TEMP_DEV);

	LOG_INF("%s ambient temperature sensor %s",
		data->amb_dev ? "Found" : "Did not find", AMB_TEMP_DEV);
	if (data->amb_dev) {
		memcpy(&data->sensor_json_descr[num_sources],
		       &json_amb_temp_descr,
		       sizeof(struct json_obj_descr));
		num_sources++;
	}

	LOG_INF("%s die temperature sensor %s",
		data->die_dev ? "Found" : "Did not find", DIE_TEMP_DEV);
	if (data->die_dev) {
		memcpy(&data->sensor_json_descr[num_sources],
		       &json_die_temp_descr,
		       sizeof(struct json_obj_descr));
		num_sources++;
	}

	if (num_sources == 0) {
		LOG_ERR("No temperature devices found.");
		return -ENODEV;
	}

	data->sensor_num_sources = num_sources;
	return 0;
}

static int elce2018_mqtt_init_data(struct elce2018_mqtt_data *data)
{
	int ret;

	ret = init_mqtt_plumbing(data);
	if (ret) {
		return ret;
	}

	ret = init_sensor_sources(data);
	if (ret) {
		return ret;
	}

	return 0;
}

static void elce2018_mqtt_net_cb(struct net_mgmt_event_callback *cb,
				 u32_t mgmt_event, struct net_if *iface)
{
	struct elce2018_mqtt_data *data = &temp_data;

	app_wq_submit_delayed(&data->mqtt_work, PUBLISH_DELAY_TIME);
}

int elce2018_mqtt_start(void)
{
	/* TODO: default interface may not be the one used by MQTT. */
	struct net_if *iface = net_if_get_default();
	int ret;

	ret = elce2018_mqtt_init_data(&temp_data);
	if (ret) {
		LOG_ERR("can't initialize: %d", ret);
		return ret;
	}

	/*
	 * Try to start publishing sensor data if the network
	 * interface is up. If it's not up, wait until it is to start
	 * publishing.
	 */
#if defined(CONFIG_NET_MGMT_EVENT)
	/* Subscribe to NET_EVENT_IF_UP if interface is not ready */
	if (!net_if_is_up(iface)) {
		net_mgmt_init_event_callback(&net_mgmt_cb,
					     elce2018_mqtt_net_cb,
					     NET_EVENT_IF_UP);
		net_mgmt_add_event_callback(&net_mgmt_cb);
		return 0;
	}
#endif

	elce2018_mqtt_net_cb(NULL, NET_EVENT_IF_UP, iface);
	return 0;
}

static int cmd_mqtt_publish(const struct shell *shell,
			    size_t argc, char **argv)
{
	elce2018_mqtt_try_to_publish(&temp_data.mqtt_work.work);
	//elce2018_mqtt_try_to_publish_chat(&temp_data.mqtt_work.work, "helo");
	return 0;
}

static int cmd_mqtt_publish_str(const struct shell *shell,
			    size_t argc, char **argv)
{
//	elce2018_mqtt_try_to_publish(&temp_data.mqtt_work.work);
	if (argc != 2) {
		LOG_ERR("Invalid arguments length");
	}

	elce2018_mqtt_try_to_publish_chat(&temp_data.mqtt_work.work, argv[1]);
	return 0;
}

static int cmd_mqtt_subscribe(const struct shell *shell, size_t argc, char **argv)
{

	static const enum mqtt_qos qos[] = {MQTT_QoS0};
	static const char * topics[] = {temp_data.mqtt_topic};

	snprintk(temp_data.sub_topic, sizeof(temp_data.sub_topic),
			 "id/+/%s",
			 (argc == 2) ? argv[1] : (char *)temp_data.mqtt_client_id);
	LOG_DBG("topic: %s", temp_data.mqtt_topic);
	mqtt_tx_subscribe(&temp_data.mqtt, 0x1234, 1, topics, qos);

	return 0;
}

static int cmd_mqtt_connect(const struct shell *shell,
			    size_t argc, char **argv)
{
	if (!temp_data.mqtt.connected) {
		int ret = elce2018_mqtt_connect(&temp_data);
		if (ret) {
			LOG_ERR("connection failed: %d", ret);
			return -1;
		}
	}
	shell_fprintf(shell, SHELL_NORMAL, "connected\n");
	return 0;
}

SHELL_CREATE_STATIC_SUBCMD_SET(sub_mqtt_cmds)
{
	SHELL_CMD(connect,NULL, ".", cmd_mqtt_connect),
	SHELL_CMD(chat,NULL, ".", cmd_mqtt_publish_str),
	SHELL_CMD(subscribe,NULL, ".", cmd_mqtt_subscribe),
	SHELL_CMD(temp,NULL, ".", cmd_mqtt_publish),
	SHELL_SUBCMD_SET_END
};

SHELL_CMD_REGISTER(mqtt, &sub_mqtt_cmds, "Whatever", NULL);
```

## src/reel_board.c
```c
/*
 * Copyright (c) 2018 Phytec Messtechnik GmbH
 * Copyright (c) 2018 Intel Corporation
 *
 * SPDX-License-Identifier: Apache-2.0
 */

#include <zephyr.h>
#include <device.h>
#include <gpio.h>
#include <display/cfb.h>
#include <misc/printk.h>
#include <flash.h>

#include <string.h>


#include "board.h"

#define EDGE (GPIO_INT_EDGE | GPIO_INT_DOUBLE_EDGE)

#ifdef SW0_GPIO_FLAGS
#define PULL_UP SW0_GPIO_FLAGS
#else
#define PULL_UP 0
#endif

#define LINE_MAX 12

static struct device *epd_dev;
static bool pressed;
static struct device *gpio;
static struct k_delayed_work epd_work;

static struct {
	struct device *dev;
	const char *name;
	u32_t pin;
} leds[] = {
	{ .name = LED0_GPIO_CONTROLLER, .pin = LED0_GPIO_PIN, },
	{ .name = LED1_GPIO_CONTROLLER, .pin = LED1_GPIO_PIN, },
	{ .name = LED2_GPIO_CONTROLLER, .pin = LED2_GPIO_PIN, },
	{ .name = LED3_GPIO_CONTROLLER, .pin = LED3_GPIO_PIN, },
};

struct k_delayed_work led_timer;

static size_t print_line(int row, const char *text, size_t len, bool center)
{
	u8_t font_height, font_width;
	u8_t line[LINE_MAX + 1];
	int pad;

	len = min(len, LINE_MAX);
	memcpy(line, text, len);
	line[len] = '\0';

	if (center) {
		pad = (LINE_MAX - len) / 2;
	} else {
		pad = 0;
	}

	cfb_get_font_size(epd_dev, 0, &font_width, &font_height);

	if (cfb_print(epd_dev, line, font_width * pad, font_height * row)) {
		printk("Failed to print a string\n");
	}

	return len;
}

static size_t get_len(const char *text)
{
	const char *space = NULL;
	size_t i;

	for (i = 0; i <= LINE_MAX; i++) {
		switch (text[i]) {
		case '\n':
		case '\0':
			return i;
		case ' ':
			space = &text[i];
			break;
		default:
			continue;
		}
	}

	/* If we got more characters than fits a line, and a space was
	 * encountered, fall back to the last space.
	 */
	if (space) {
		return space - text;
	}

	return LINE_MAX;
}

void board_blink_leds(void)
{
	k_delayed_work_submit(&led_timer, K_MSEC(100));
}

void board_show_text(const char *text, bool center, s32_t duration)
{
	int i;

	cfb_framebuffer_set_font(epd_dev, 0);
	cfb_framebuffer_clear(epd_dev, false);

	for (i = 0; i < 3; i++) {
		size_t len;

		while (*text == ' ' || *text == '\n') {
			text++;
		}

		len = get_len(text);
		if (!len) {
			break;
		}

		text += print_line(i, text, len, center);
		if (!*text) {
			break;
		}
	}

	cfb_framebuffer_finalize(epd_dev);

	if (duration != K_FOREVER) {
		k_delayed_work_submit(&epd_work, duration);
	}
}

static void epd_update(struct k_work *work)
{
	board_show_text("kuba", true, K_FOREVER);
}

static bool button_is_pressed(void)
{
	u32_t val;

	gpio_pin_read(gpio, SW0_GPIO_PIN, &val);

	return !val;
}

static void button_interrupt(struct device *dev, struct gpio_callback *cb,
			     u32_t pins)
{
	if (button_is_pressed() == pressed) {
		return;
	}

	pressed = !pressed;
	printk("Button %s\n", pressed ? "pressed" : "released");

	/* We only care about button release for now */
	if (pressed) {
		return;
	}
}

static int configure_button(void)
{
	static struct gpio_callback button_cb;

	gpio = device_get_binding(GPIO_KEYS_BUTTON_0_GPIO_CONTROLLER);
	if (!gpio) {
		return -ENODEV;
	}

	gpio_pin_configure(gpio, SW0_GPIO_PIN,
			   (GPIO_DIR_IN | GPIO_INT |  PULL_UP | EDGE));

	gpio_init_callback(&button_cb, button_interrupt, BIT(SW0_GPIO_PIN));
	gpio_add_callback(gpio, &button_cb);

	gpio_pin_enable_callback(gpio, SW0_GPIO_PIN);

	return 0;
}

static void led_timeout(struct k_work *work)
{
	static int led_cntr;
	int i;

	/* Disable all LEDs */
	for (i = 0; i < ARRAY_SIZE(leds); i++) {
		gpio_pin_write(leds[i].dev, leds[i].pin, 1);
	}

	/* Stop after 5 iterations */
	if (led_cntr > (ARRAY_SIZE(leds) * 5)) {
		led_cntr = 0;
		return;
	}

	/* Select and enable current LED */
	i = led_cntr++ % ARRAY_SIZE(leds);
	gpio_pin_write(leds[i].dev, leds[i].pin, 0);

	k_delayed_work_submit(&led_timer, K_MSEC(100));
}

static int configure_leds(void)
{
	int i;

	for (i = 0; i < ARRAY_SIZE(leds); i++) {
		leds[i].dev = device_get_binding(leds[i].name);
		if (!leds[i].dev) {
			printk("Failed to get %s device\n", leds[i].name);
			return -ENODEV;
		}

		gpio_pin_configure(leds[i].dev, leds[i].pin, GPIO_DIR_OUT);
		gpio_pin_write(leds[i].dev, leds[i].pin, 1);

	}

	k_delayed_work_init(&led_timer, led_timeout);
	return 0;
}

static int erase_storage(void)
{
	return 0;
}

void board_refresh_display(void)
{
	k_delayed_work_submit(&epd_work, K_NO_WAIT);
}

int board_init(void)
{
	epd_dev = device_get_binding(CONFIG_SSD1673_DEV_NAME);
	if (epd_dev == NULL) {
		printk("SSD1673 device not found\n");
		return -ENODEV;
	}

	if (cfb_framebuffer_init(epd_dev)) {
		printk("Framebuffer initialization failed\n");
		return -EIO;
	}

	cfb_framebuffer_clear(epd_dev, true);

	if (configure_button()) {
		printk("Failed to configure button\n");
		return -EIO;
	}

	if (configure_leds()) {
		printk("LED init failed\n");
		return -EIO;
	}

	k_delayed_work_init(&epd_work, epd_update);

	pressed = button_is_pressed();
	if (pressed) {
		printk("Erasing storage\n");
		board_show_text("Resetting Device", false, K_SECONDS(4));
		erase_storage();
	}

	return 0;
}
```
