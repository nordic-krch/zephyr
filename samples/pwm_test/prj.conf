## CMakeLists.txt
```
# SPDX-License-Identifier: Apache-2.0

cmake_minimum_required(VERSION 3.20.0)

find_package(Zephyr REQUIRED HINTS $ENV{ZEPHYR_BASE})
project(pwm_test)

target_sources(app PRIVATE src/main.c)
```

## prj.conf
```kconfig
CONFIG_NRFX_PWM130=y
CONFIG_NRFX_PWM20=y
CONFIG_NRFX_PWM0=y
CONFIG_NRFX_GPPI=y
CONFIG_NRFX_TIMER130=y
CONFIG_NRFX_TIMER20=y
CONFIG_NRFX_TIMER0=y
CONFIG_PPI_TRACE=y
CONFIG_LOG=y
```

## nrf54h20dk_nrf54h20_cpuapp.overlay
```dts
// To get started, press Ctrl+Space to bring up the completion menu and view the available nodes.

// You can also use the buttons in the sidebar to perform actions on nodes.
// Actions currently available include:

// * Enabling / disabling the node
// * Adding the bus to a bus
// * Removing the node
// * Connecting ADC channels

// For more help, browse the DeviceTree documentation at https://docs.zephyrproject.org/latest/guides/dts/index.html
// You can also visit the nRF DeviceTree extension documentation at https://docs.nordicsemi.com/bundle/nrf-connect-vscode/page/guides/ncs_configure_app.html#devicetree-support-in-the-extension
&dppic133 {
    compatible = "nordic,nrf-dppic-global";
    /* Remove default channels assignment */
    /delete-property/ owned-channels;
    /delete-property/ source-channels;
    /delete-property/ sink-channels;
    /delete-property/ nonsecure-channels;
    status = "okay";
    owned-channels = <0 1 2 3>;
    sink-channels = <3>;
    source-channels = < 1 2 >;
};
```

## src/main.c
```c
/*
 * Copyright (c) 2012-2014 Wind River Systems, Inc.
 *
 * SPDX-License-Identifier: Apache-2.0
 */

#include <zephyr/kernel.h>
#include <nrfx_pwm.h>
#include <hal/nrf_pwm.h>
#include <nrfx_timer.h>
#include <zephyr/irq.h>
#include <helpers/nrfx_gppi.h>
#include <haly/nrfy_gpio.h>


#ifdef CONFIG_SOC_NRF54H20_CPUAPP
#define OUTPUT_PIN DT_GPIO_PIN(DT_ALIAS(led2), gpios)
#define PWM_INSTANCE 130
#define TIMER_INSTANCE 130
#define PWM_LABEL pwm130
#elif CONFIG_SOC_NRF54L15_CPUAPP
#define OUTPUT_PIN (32+13)
#define DEBUG_PIN (32+14)
#define DEBUG2_PIN (32+12)
#define PWM_INSTANCE 20
#define TIMER_INSTANCE 20
#define DPPI_INSTANCE 20
#define PWM_LABEL pwm20
#elif CONFIG_SOC_NRF5340_CPUAPP
#define OUTPUT_PIN (32+3)
#define DEBUG_PIN (32+3)
#define PWM_INSTANCE 0
#define TIMER_INSTANCE 0
#define DPPI_INSTANCE 0
#define PWM_LABEL pwm0
#else
#error "Unsupported"
#endif
static const nrfx_pwm_t pwm_instance = NRFX_PWM_INSTANCE(PWM_INSTANCE);
static nrf_pwm_values_common_t pwm_val[] = {0x500, 0x500, 0x500, 0x500, 0x500, 0x500, 0x500, 0x500, 0x500, 0x500};
static nrf_pwm_sequence_t seq = {
	.values = {pwm_val},
	.length = ARRAY_SIZE(pwm_val),
	.repeats = 0,
	.end_delay = 0
};


static void pwm_isr(void)
{
	static uint32_t evt_counter;

	// pwm_instance.p_reg->EVENTS_COMPAREMATCH[0] = 0;
	printk("PWM compare match count: %d\n", ++evt_counter);
}

static uint32_t pwm_init(void)
{
	nrfx_err_t err;

	nrfx_pwm_config_t pwm_config =
		NRFX_PWM_DEFAULT_CONFIG(OUTPUT_PIN, NRF_PWM_PIN_NOT_CONNECTED,
					NRF_PWM_PIN_NOT_CONNECTED, NRF_PWM_PIN_NOT_CONNECTED);

	pwm_config.top_value = 0x1000;
	/* Connect pwm130 IRQ to nrfx_pwm_irq_handler */
	IRQ_CONNECT(DT_IRQN(DT_NODELABEL(PWM_LABEL)), DT_IRQ(DT_NODELABEL(PWM_LABEL), priority), nrfx_isr,
		    pwm_isr, 0);

	err = nrfx_pwm_init(&pwm_instance, &pwm_config, NULL, NULL);
	if (err != NRFX_SUCCESS) {
		printk("nrfx_pwm_init() failed. (err 0x%x)\n", err);
		return -1;
	}

	// nrfy_pwm_int_set(pwm_instance.p_reg, PWM_INTENSET_COMPAREMATCH0_Msk);

	return (uint32_t)&pwm_instance.p_reg->EVENTS_COMPAREMATCH[0];
}

static uint32_t timer_init(void)
{
	nrfx_err_t err;
	static const nrfx_timer_t timer_instance = NRFX_TIMER_INSTANCE(TIMER_INSTANCE);

	uint32_t base_frequency = NRF_TIMER_BASE_FREQUENCY_GET(timer_instance.p_reg);
    nrfx_timer_config_t timer_config = NRFX_TIMER_DEFAULT_CONFIG(base_frequency);
	timer_config.bit_width = NRF_TIMER_BIT_WIDTH_16;
    timer_config.mode = NRF_TIMER_MODE_COUNTER;

	printk("Timer base frequency: %d Hz\n", base_frequency);

	err = nrfx_timer_init(&timer_instance, &timer_config, NULL);
	if (err != NRFX_SUCCESS) {
		printk("nrfx_timer_init() failed. (err 0x%x)\n", err);
		return -1;
	}

	nrfx_timer_enable(&timer_instance);

	return nrfx_timer_task_address_get(&timer_instance, NRF_TIMER_TASK_COUNT);
}

#ifdef CONFIG_PPI_TRACE
#include <debug/ppi_trace.h>
static void ppi_trace_init(uint32_t ppi_ch)
{
	nrfx_dppi_t dppi = NRFX_DPPI_INSTANCE(DPPI_INSTANCE);
	uint32_t pin = DEBUG_PIN;
	int err = ppi_trace_dppi_ch_trace(pin, ppi_ch, &dppi);
	printk("ppi setup:%d\n", err);
}
#endif

int main(void)
{
	nrfx_err_t nrfx_err;
	uint32_t timer_task;
	uint32_t pwm_event;
	uint8_t ppi_channel;

    nrfy_gpio_cfg_output(OUTPUT_PIN);
    nrfy_gpio_pin_set(OUTPUT_PIN);

	pwm_event = pwm_init();
	timer_task = timer_init();

	nrfx_err = nrfx_gppi_channel_alloc(&ppi_channel);
	if (nrfx_err != NRFX_SUCCESS) {
		printk("nrfx_gppi_channel_alloc error: 0x%08X", nrfx_err);
		return 0;
	}

	printk("Using PPI channel %d\n", ppi_channel);

	nrfx_gppi_channel_endpoints_setup(ppi_channel, pwm_event, timer_task);
	nrfx_gppi_channels_enable(BIT(ppi_channel));

#ifdef CONFIG_PPI_TRACE
	uint32_t ch = *(uint32_t *)(pwm_event+0x80) & 0xff;
	ppi_trace_init(ch);
#endif

	static const nrfx_timer_t timer_instance = NRFX_TIMER_INSTANCE(TIMER_INSTANCE);

	/*nrf_gpio_cfg_output(32+12);*/
    while (1) {
        nrfx_timer_capture(&timer_instance, 0);
        uint32_t before = nrfx_timer_capture_get(&timer_instance, 0);

	    nrfx_pwm_simple_playback(&pwm_instance, &seq, 1, NRFX_PWM_FLAG_STOP);

        k_msleep(10);

        nrfx_timer_capture(&timer_instance, 0);
        uint32_t after = nrfx_timer_capture_get(&timer_instance, 0);

        printk("before: %u after %u delta %u\n", before, after, after - before);

        k_msleep(1000);

    }

	return 0;
}
```
