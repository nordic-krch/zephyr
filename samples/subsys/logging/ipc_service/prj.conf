## prj.conf
```kconfig
CONFIG_TIMESLICE_SIZE=1
CONFIG_MAIN_STACK_SIZE=2048
CONFIG_HEAP_MEM_POOL_SIZE=4096

# Configuration IPC Service
CONFIG_IPC_SERVICE=y
CONFIG_IPC_SERVICE_BACKEND_RPMSG_MULTI_INSTANCE=y

# Configuration backend for IPC Service
CONFIG_OPENAMP=y
CONFIG_OPENAMP_SLAVE=n

CONFIG_RPMSG_MULTI_INSTANCE_MASTER=y
CONFIG_RPMSG_MULTI_INSTANCES_NO=2

CONFIG_LOG=y
CONFIG_LOG_MULTIDOMAIN=y
CONFIG_LOG_LINK_IPC_SERVICE=y

CONFIG_ASSERT=y
#CONFIG_TRACING=y
#CONFIG_SEGGER_SYSTEMVIEW=y
#CONFIG_IDLE_STACK_SIZE=2048
#CONFIG_LOG_BACKEND_RTT=n
#CONFIG_LOG_PRINTK=n
```

## src/main.c
```c
/*
 * Copyright (c) 2021 Nordic Semiconductor ASA
 *
 * SPDX-License-Identifier: Apache-2.0
 */

#include <zephyr.h>
#include <logging/log.h>
LOG_MODULE_REGISTER(main);

void main(void)
{
	int cnt = 0;

	while (1) {
//		LOG_INF("Test %d", cnt++);
		k_msleep(500);
	}
}
```
