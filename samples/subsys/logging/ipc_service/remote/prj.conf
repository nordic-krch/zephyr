## prj.conf
```kconfig
CONFIG_STDOUT_CONSOLE=n
CONFIG_PRINTK=n
CONFIG_IPM=y
CONFIG_HEAP_MEM_POOL_SIZE=4096
CONFIG_SEGGER_RTT_BUFFER_SIZE_UP=4096

# Configuration IPC Service
CONFIG_IPC_SERVICE=y
CONFIG_IPC_SERVICE_BACKEND_RPMSG_MULTI_INSTANCE=y

# Configuration backend for IPC Service
CONFIG_OPENAMP=y
CONFIG_OPENAMP_MASTER=n

CONFIG_RPMSG_MULTI_INSTANCE_REMOTE=y
CONFIG_RPMSG_MULTI_INSTANCES_NO=2

CONFIG_LOG=y
CONFIG_LOG2_MODE_DEFERRED=y
CONFIG_LOG_BACKEND_IPC_SERVICE=y

CONFIG_ASSERT=y
```

## src/main.c
```c
/*
 * Copyright (c) 2021 Nordic Semiconductor ASA
 *
 * SPDX-License-Identifier: Apache-2.0
 */

#include <zephyr.h>
#include <logging/log.h>
#include <hal/nrf_gpio.h>
LOG_MODULE_REGISTER(main);

void main(void)
{
	nrf_gpio_cfg_output(32+14);
	nrf_gpio_cfg_output(32+15);

	int cnt = 0;

		LOG_INF("Test %d", cnt++);
	while (1) {
//		printk("Test %d\n", cnt);
		cnt++;
		LOG_INF("Test %d", cnt);
		k_msleep(500);
	}
}
```
