/* SPDX-License-Identifier: Apache-2.0 */

&uart2 {
	compatible = "nordic,nrf-uarte";
	current-speed = <115200>;
	status = "okay";
	tx-pin = <18>;
	rx-pin = <17>;
	/delete-property/ rts-pin;
	/delete-property/ cts-pin;
};
