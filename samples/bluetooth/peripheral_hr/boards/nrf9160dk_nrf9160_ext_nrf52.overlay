/* SPDX-License-Identifier: Apache-2.0 */

&uart2 {
	compatible = "nordic,nrf-uarte";
	current-speed = <115200>;
	status = "okay";
	rx-pin = <12>;
	tx-pin = <13>;
	/delete-property/ rts-pin;
	/delete-property/ cts-pin;
};
