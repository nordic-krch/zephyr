## CMakeLists.txt
```
#
# Copyright (c) 2026 Nordic Semiconductor ASA
#
# SPDX-License-Identifier: Apache-2.0
#

cmake_minimum_required(VERSION 3.20.0)

find_package(Zephyr REQUIRED HINTS $ENV{ZEPHYR_BASE})

project(coresight_stm_shell_remote)

target_sources(app PRIVATE src/main.c)
```

## prj.conf
```kconfig
# Copyright (c) 2026 Nordic Semiconductor ASA
# SPDX-License-Identifier: Apache-2.0

CONFIG_IPC_SERVICE=y
CONFIG_MBOX=y

CONFIG_SHELL=y
CONFIG_SHELL_REMOTE_CLI=y
CONFIG_SHELL_BACKEND_SERIAL=n

CONFIG_LOG_RUNTIME_FILTERING=y
CONFIG_LOG_CMDS=y

CONFIG_BOOT_BANNER=n
CONFIG_GPIO=n
CONFIG_SERIAL=n
CONFIG_CONSOLE=n
CONFIG_UART_CONSOLE=n
CONFIG_PRINTK=n

# Use thread shell commands
CONFIG_INIT_STACKS=y
CONFIG_THREAD_STACK_INFO=y
CONFIG_KERNEL_SHELL=y
CONFIG_THREAD_MONITOR=y
CONFIG_THREAD_RUNTIME_STATS=y
CONFIG_THREAD_RUNTIME_STATS_USE_TIMING_FUNCTIONS=y
CONFIG_THREAD_NAME=y
```

## boards/nrf54h20dk_nrf54h20_cpuflpr.conf
```kconfig
# Copyright (c) 2026 Nordic Semiconductor ASA
# SPDX-License-Identifier: Apache-2.0
#
# CPUFLPR has limited RAM.

CONFIG_LOG=n
CONFIG_LOG_CMDS=n
CONFIG_KERNEL_SHELL=n
CONFIG_THREAD_MONITOR=n
CONFIG_THREAD_RUNTIME_STATS=n
CONFIG_STATS=n
CONFIG_STATS_SHELL=n
CONFIG_DEVICE_SHELL=n
CONFIG_INIT_STACKS=n
CONFIG_THREAD_STACK_INFO=n

CONFIG_PBUF_RX_READ_BUF_SIZE=128
CONFIG_IPC_SERVICE_BACKEND_ICMSG_WQ_STACK_SIZE=1024
```

## boards/nrf54h20dk_nrf54h20_cpuppr.conf
```kconfig
# Copyright (c) 2026 Nordic Semiconductor ASA
# SPDX-License-Identifier: Apache-2.0
#
# CPUPPR has limited RAM.

CONFIG_LOG=n
CONFIG_LOG_CMDS=n
CONFIG_KERNEL_SHELL=n
CONFIG_THREAD_MONITOR=n
CONFIG_THREAD_RUNTIME_STATS=n
CONFIG_STATS=n
CONFIG_STATS_SHELL=n
CONFIG_DEVICE_SHELL=n
CONFIG_INIT_STACKS=n
CONFIG_THREAD_STACK_INFO=n

CONFIG_PBUF_RX_READ_BUF_SIZE=128
CONFIG_IPC_SERVICE_BACKEND_ICMSG_WQ_STACK_SIZE=1024
```

## src/main.c
```c
/*
 * Copyright (c) 2026 Nordic Semiconductor ASA
 *
 * SPDX-License-Identifier: Apache-2.0
 */

#include <zephyr/kernel.h>
#include <zephyr/shell/shell.h>
#include <zephyr/logging/log.h>
LOG_MODULE_REGISTER(app, LOG_LEVEL_DBG);

static int cmd_ping(const struct shell *sh, size_t argc, char **argv)
{
	ARG_UNUSED(argc);
	ARG_UNUSED(argv);

	LOG_ERR("error %d", 100);
	LOG_WRN("warning %lld", 0x1234567890LL);
	LOG_INF("info %s", "test");
	LOG_DBG("debug %d %d", 1000, 100);
	shell_print(sh, "pong %s", CONFIG_BOARD_TARGET);
	return 0;
}

SHELL_CMD_REGISTER(ping, NULL, "Remote shell ping", cmd_ping);

int main(void)
{
	return 0;
}
```
